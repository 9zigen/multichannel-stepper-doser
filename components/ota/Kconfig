## components/ota/Kconfig
```kconfig
menu "OTA"

config OTA_URL
    string "OTA URL"
	default "http://192.168.4.2:8070/tft_doser.bin"
	help
		HTTP Server url to download the image file from.

		See example README.md for details.

endmenu
```

## defconfig
```kconfig
CONFIG_ESPTOOLPY_FLASHSIZE_8MB=y
CONFIG_ESPTOOLPY_HEADER_FLASHSIZE_UPDATE=y
CONFIG_PARTITION_TABLE_CUSTOM=y
CONFIG_CONTROLLER_ENABLE_BLE_PROVISIONING=y
CONFIG_BT_ENABLED=y
CONFIG_BTDM_CTRL_MODE_BLE_ONLY=y
CONFIG_BT_NIMBLE_ENABLED=y
# CONFIG_BT_NIMBLE_ROLE_CENTRAL is not set
CONFIG_BT_NIMBLE_ROLE_PERIPHERAL=y
CONFIG_BT_NIMBLE_ROLE_BROADCASTER=y
# CONFIG_BT_NIMBLE_ROLE_OBSERVER is not set
# CONFIG_BT_NIMBLE_GATT_CLIENT is not set
CONFIG_BT_NIMBLE_GATT_SERVER=y
CONFIG_BT_NIMBLE_MAX_BONDS=1
CONFIG_BT_NIMBLE_MAX_CONNECTIONS=1
# CONFIG_BT_NIMBLE_PROX_SERVICE is not set
# CONFIG_BT_NIMBLE_ANS_SERVICE is not set
# CONFIG_BT_NIMBLE_CTS_SERVICE is not set
# CONFIG_BT_NIMBLE_HTP_SERVICE is not set
# CONFIG_BT_NIMBLE_IPSS_SERVICE is not set
# CONFIG_BT_NIMBLE_TPS_SERVICE is not set
# CONFIG_BT_NIMBLE_IAS_SERVICE is not set
# CONFIG_BT_NIMBLE_LLS_SERVICE is not set
# CONFIG_BT_NIMBLE_SPS_SERVICE is not set
# CONFIG_BT_NIMBLE_HR_SERVICE is not set
# CONFIG_BT_NIMBLE_BAS_SERVICE is not set
# CONFIG_BT_NIMBLE_DIS_SERVICE is not set
# CONFIG_ESP_WIFI_IRAM_OPT is not set
CONFIG_HTTPD_MAX_REQ_HDR_LEN=2048
CONFIG_HTTPD_MAX_URI_LEN=1024
CONFIG_HTTPD_WS_SUPPORT=y
CONFIG_HTTPD_WS_PRE_HANDSHAKE_CB_SUPPORT=y
CONFIG_ESP_COREDUMP_ENABLE_TO_FLASH=y
CONFIG_ESP_COREDUMP_FLASH_NO_OVERWRITE=y
CONFIG_FREERTOS_TIMER_TASK_STACK_DEPTH=3072
CONFIG_LWIP_MAX_SOCKETS=16
```

## main/Kconfig.projbuild
```kconfig
menu "Dosing Pump Controller Configuration"

config CONTROLLER_ENABLE_BLE_PROVISIONING
    bool "Enable BLE provisioning"
    default y
    help
        Enable the BLE-assisted onboarding flow. When disabled, the firmware
        uses the legacy AP-only onboarding behavior and does not depend on the
        BLE provisioning component.

config CONTROLLER_WIFI_SSID
    string "AP WiFi SSID"
    default "DOSING"
    help
        SSID (network name) for the example to connect to.

config CONTROLLER_WIFI_PASS
    string "AP WiFi Password"
    default "12345678"
    help
        WiFi password (WPA2 or WPA3) for the example to use.
        Can be left blank if the network has no security set.

config CONTROLLER_WIFI_CHANNEL
    int "WiFi Channel"
    range 1 13
    default 1
    help
        WiFi SoftAp channel (network channel).

config CONTROLLER_WIFI_AP_GRACE_TIMEOUT_SEC
    int "AP grace timeout (seconds)"
    depends on CONTROLLER_ENABLE_BLE_PROVISIONING
    range 10 3600
    default 120
    help
        How long the fallback AP should remain available after a successful
        provisioning/recovery station connection before switching to STA-only,
        unless keep_ap_active is enabled.

config CONTROLLER_WIFI_AP_FALLBACK_TIMEOUT_SEC
    int "AP fallback timeout (seconds)"
    range 30 3600
    default 300
    help
        How long the recovery/fallback AP should remain active without clients
        before retrying the station connection sequence.

endmenu
```

## sdkconfig.defaults.legacy
```kconfig
# Legacy AP-only firmware profile.
# Apply this on top of defconfig to strip BLE provisioning and re-enable the
# faster Wi-Fi IRAM path when Bluetooth is not needed.

# CONFIG_CONTROLLER_ENABLE_BLE_PROVISIONING is not set
# CONFIG_BT_ENABLED is not set
CONFIG_ESP_WIFI_IRAM_OPT=y
```
